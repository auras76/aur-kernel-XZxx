## kitakami_defconfig
```kconfig
##########################
#### Auras76 Kernel ####
##########################

# Disable unwanted things
CONFIG_SECURITY_SONY_RIC=n
# CONFIG_DM_VERITY is not set
CONFIG_SECURITY_SELINUX_BOOTPARAM_VALUE=1
CONFIG_SECURITY_SELINUX_DISABLE=y
CONFIG_SECURITY_SELINUX_DEVELOP=y
CONFIG_SECURITY_SELINUX_AVC_STATS=y
# CONFIG_SECURITY_SELINUX_AVC_EXTRA_INFO is not set
# CONFIG_SECURITY_SELINUX_TRAP is not set
```
